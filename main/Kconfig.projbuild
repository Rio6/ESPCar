## main/Kconfig.projbuild
```kconfig
menu "Project Configuration"
   config MAX_CONNECTION
      int "Max numberof connections"
      default 5

   config CONNECTION_TIMEOUT
      int "Milliseconds before closing idle connection"
      default 3000

   config STATUS_INTERVAL
      int "Milliseconds between each status update"
      default 50

   config CAMERA_FPS_CAP
      int "Camera FPS Cap"
      default 30

   config CONTROL_PORT
      int "Control Port"
      default 3232

   config WIFI_SSID
      string "Wifi SSID"

   config WIFI_PASS
      string "Wifi Password"
endmenu
```
